## Kconfig
```kconfig
config NODEMCU_CMODULE_IRPWM
    depends on IDF_TARGET_ESP32 && NODEMCU_CMODULE_TURCUTILS
    bool "IRPWM module"
    default "n"
    help
        Includes the irpwm module from
        https://github.com/tomsci/nodemcu-irpwm
```
